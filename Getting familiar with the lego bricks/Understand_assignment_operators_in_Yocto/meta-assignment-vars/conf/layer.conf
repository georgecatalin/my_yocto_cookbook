## Getting familiar with the lego bricks/Understand_assignment_operators_in_Yocto/meta-assignment-vars/conf/layer.conf
```bitbake
# We have a conf and classes directory, add to BBPATH
BBPATH .= ":${LAYERDIR}"

# We have recipes-* directories, add to BBFILES
BBFILES += "${LAYERDIR}/recipes-*/*/*.bb \
            ${LAYERDIR}/recipes-*/*/*.bbappend"

BBFILE_COLLECTIONS += "meta-assignment-vars"
BBFILE_PATTERN_meta-assignment-vars = "^${LAYERDIR}/"
BBFILE_PRIORITY_meta-assignment-vars = "6"

LAYERDEPENDS_meta-assignment-vars = "core"
LAYERSERIES_COMPAT_meta-assignment-vars = "kirkstone"
```

## Getting familiar with the lego bricks/oe_runmake_and_makefile/dirs/meta_advanced-calculator-makefile/conf/layer.conf
```bitbake
# We have a conf and classes directory, add to BBPATH
BBPATH .= ":${LAYERDIR}"

# We have recipes-* directories, add to BBFILES
BBFILES += "${LAYERDIR}/recipes-*/*/*.bb \
            ${LAYERDIR}/recipes-*/*/*.bbappend"

BBFILE_COLLECTIONS += "meta-advanced-calculator"
BBFILE_PATTERN_meta-advanced-calculator = "^${LAYERDIR}/"
BBFILE_PRIORITY_meta-advanced-calculator = "6"

LAYERDEPENDS_meta-advanced-calculator = "core"
LAYERSERIES_COMPAT_meta-advanced-calculator = "kirkstone"
```

## Understand build tasks with Yocto Project/practical_example_to_use_do_fetch_operation/dirs/conf/layer.conf
```bitbake
# We have a conf and classes directory, add to BBPATH
BBPATH .= ":${LAYERDIR}"

# We have recipes-* directories, add to BBFILES
BBFILES += "${LAYERDIR}/recipes-*/*/*.bb \
            ${LAYERDIR}/recipes-*/*/*.bbappend"

BBFILE_COLLECTIONS += "meta-do_fetch_example"
BBFILE_PATTERN_meta-do_fetch_example = "^${LAYERDIR}/"
BBFILE_PRIORITY_meta-do_fetch_example = "6"

LAYERDEPENDS_meta-do_fetch_example = "core"
LAYERSERIES_COMPAT_meta-do_fetch_example = "kirkstone"
```

## Understand the use of devtool in different scenarios/practical_example_patching_using_devtool_modify/dirs/conf/bblayers.conf
```bitbake
# POKY_BBLAYERS_CONF_VERSION is increased each time build/conf/bblayers.conf
# changes incompatibly
POKY_BBLAYERS_CONF_VERSION = "2"

BBPATH = "${TOPDIR}"
BBFILES ?= ""

BBLAYERS ?= " \
  /home/georgeca/yocto_tutorial/poky/meta \
  /home/georgeca/yocto_tutorial/poky/meta-poky \
  /home/georgeca/yocto_tutorial/poky/meta-yocto-bsp \
  /home/georgeca/yocto_tutorial/poky/meta-openembedded/meta-oe \
  /home/georgeca/yocto_tutorial/poky/meta-george \
  /home/georgeca/yocto_tutorial/my_builds/workspace \
  /home/georgeca/yocto_tutorial/poky/meta-george-append-layer \
  "
```

## Understand the use of devtool in different scenarios/practical_example_patching_using_devtool_modify/dirs/meta-george-append-layer/conf/layer.conf
```bitbake
# We have a conf and classes directory, add to BBPATH
BBPATH .= ":${LAYERDIR}"

# We have recipes-* directories, add to BBFILES
BBFILES += "${LAYERDIR}/recipes-*/*/*.bb \
            ${LAYERDIR}/recipes-*/*/*.bbappend"

BBFILE_COLLECTIONS += "meta-george-append-layer"
BBFILE_PATTERN_meta-george-append-layer = "^${LAYERDIR}/"
BBFILE_PRIORITY_meta-george-append-layer = "6"

LAYERDEPENDS_meta-george-append-layer = "core"
LAYERSERIES_COMPAT_meta-george-append-layer = "kirkstone"
```
